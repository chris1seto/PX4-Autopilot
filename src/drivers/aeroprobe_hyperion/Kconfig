## src/drivers/aeroprobe_hyperion/Kconfig
```kconfig
menuconfig DRIVERS_AEROPROBE_HYPERION
	bool "aeroprobe_hyperion"
	default y
	---help---
		Enable support for aeroprobe_hyperion
```

## src/drivers/radical_can/Kconfig
```kconfig
menuconfig DRIVERS_RADICAL_CAN
	bool "radical_can"
	default y
	---help---
		Enable support for radical_can
```
